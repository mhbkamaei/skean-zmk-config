## config/boards/arm/skean/Kconfig.board
```kconfig
#
# Copyright (c) 2021 The ZMK Contributors
# SPDX-License-Identifier: MIT
#

choice
	prompt "Choice"

config BUILD_OUTPUT_UF2_FAMILY_ID
    default "0x72721d4e"

endchoice

config BOARD_SKEAN_LEFT
	bool "skean_left"
	depends on SOC_NRF52832_QFAA

config BOARD_SKEAN_RIGHT
	bool "skean_right"
	depends on SOC_NRF52832_QFAA
```
